#define CONFIG_WIRELESS
#define ZMK_BASE_LAYER(name, LT, RT, LM, RM, LB, RB, LH, RH) \
    ZMK_LAYER(                                               \
        name,                                                \
        LT RT  \
        LM RM  \
        LB RB  \
        LH RH  \
    )

#include "altyr_key_labels.h"
#include "base.keymap"
