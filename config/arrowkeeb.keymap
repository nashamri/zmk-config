#ifdef CONFIG_ZMK_BLE
#define CONFIG_WIRELESS
#endif
#define ZMK_BASE_LAYER(name, LT, RT, LM, RM, LB, RB, LH, RH) \
    ZMK_LAYER(                                               \
        name,                                                \
        LT RT  \
        LM RM  \
        LB RB  \
        &none &none LH RH &none &none  \
    )

#include "arrowkeeb_key_labels.h"
#include "base.keymap"
