#include <behaviors.dtsi>
#include <behaviors/num_word.dtsi> // Requires zmk-auto-layer module.
#include <behaviors/unicode.dtsi> // Requires zmk-unicode module.
#include <zmk-helpers/helper.h> // Requires zmk-helpers module.
#include <dt-bindings/zmk/keys.h>
#ifdef CONFIG_WIRELESS
  #include <dt-bindings/zmk/bt.h>
  #include <dt-bindings/zmk/outputs.h>
  #define _BT_SEL_KEYS_                                                        \
      &bt BT_SEL 0 &bt BT_SEL 1 &bt BT_SEL 2 &bt BT_SEL 3 &bt BT_SEL 4
  #define _BT_OUT_ &out OUT_TOG
#else
  #define _BT_SEL_KEYS_ &trans &trans &trans &trans &trans
  #define _BT_OUT_ &trans
#endif

#ifdef RGB
  #define _RGB_TOG_ &rgb_ug RGB_TOG
#else
  #define _RGB_TOG_ &trans
#endif

#define DEF 0
#define SYM 1
#define NAV 2
#define FN 3
#define GAME 4
#define NUM 5
#define SYS 6
#define MOUSE 7

#define XXX &none
#define ___ &trans

/* Global defaults */

#define QUICK_TAP_MS 195

&sk {
  release-after-ms = <900>;
  quick-release;
};

&sl { // Allow sticky mods to chord across sticky layers.
  ignore-modifiers;
};

&lt {
  flavor = "balanced";
  tapping-term-ms = <200>;
  quick-tap-ms = <QUICK_TAP_MS>;
};

/* Homerow mods */

#define KEYS_L LT0 LT1 LT2 LT3 LT4 LM0 LM1 LM2 LM3 LM4 LB0 LB1 LB2 LB3 LB4
#define KEYS_R RT0 RT1 RT2 RT3 RT4 RM0 RM1 RM2 RM3 RM4 RB0 RB1 RB2 RB3 RB4
#ifndef LH2
  #define THUMBS LH1 LH0 RH0 RH1         // Thumbs on 34 keys.
#else
  #define THUMBS LH2 LH1 LH0 RH0 RH1 RH2 // Thumbs on 36+ keys.
#endif

#define MAKE_HRM(NAME, HOLD, TAP, TRIGGER_POS)                                 \
  ZMK_HOLD_TAP(NAME, bindings = <HOLD>, <TAP>; flavor = "balanced";            \
               tapping-term-ms = <280>; quick-tap-ms = <QUICK_TAP_MS>;         \
               require-prior-idle-ms = <100>; hold-trigger-on-release;         \
               hold-trigger-key-positions = <TRIGGER_POS>;)

MAKE_HRM(hml, &kp, &kp, KEYS_R THUMBS) // Left-hand HRMs.
MAKE_HRM(hmr, &kp, &kp, KEYS_L THUMBS) // Right-hand HRMs.
MAKE_HRM(hmlm, &mo, &kp, KEYS_R THUMBS) // Left-hand HRMs  (momentary layer).
MAKE_HRM(hmrm, &mo, &kp, KEYS_L THUMBS) // Right-hand HRMs (momentary layer).

// Hack: Make HRM combos tap-only (cf, ZMK issue #544).
#define ZMK_COMBO_8(NAME, TAP, POS, LAYERS, COMBO_MS, IDLE_MS, HOLD, SIDE)     \
  MAKE_HRM(hm_combo_##NAME, &kp, TAP, SIDE THUMBS)                             \
  ZMK_COMBO_6(NAME, &hm_combo_##NAME HOLD 0, POS, LAYERS, COMBO_MS, IDLE_MS)

/* Combos, mouse emulation */

#include "combos.dtsi" // Must be sourced after HRM-combo hack.
#include "mouse.dtsi"

/* Nav cluster */

// Trigger tap-action on all interrupts.
#define MT_CORE                                                                \
  flavor = "tap-preferred";                                                    \
  tapping-term-ms = <220>;                                                     \
  quick-tap-ms = <220>;                                                        \
  hold-trigger-key-positions = <0>;

&mt { MT_CORE };

ZMK_HOLD_TAP(mt_home, bindings = <&masked_home>, <&kp>; MT_CORE)
ZMK_HOLD_TAP(mt_end, bindings = <&masked_end>, <&kp>; MT_CORE)

#define NAV_LEFT  &mt_home 0   LEFT  // Tap: left  | Long-tap: start of line.
#define NAV_RIGHT &mt_end 0    RIGHT // Tap: right | Long-tap: end   of line.
#define NAV_UP    &mt LC(HOME) UP    // Tap: up    | Long-tap: start of doc.
#define NAV_DOWN  &mt LC(END)  DOWN  // Tap: down  | Long-tap: end   of doc.
#define NAV_BSPC  &mt LC(BSPC) BSPC  // Tap: bspc  | Long-tap: delete word bwd.
#define NAV_DEL   &mt LC(DEL)  DEL   // Tap: del   | Long-tap: delete word fwd.

// Mask CTRL on left/right hold to avoid accidental jumps to start/end of doc.
#define MASK_MODS(NAME, MODS, BINDING)                                         \
  ZMK_MOD_MORPH(NAME, bindings = <BINDING>, <BINDING>; mods = <MODS>;)

MASK_MODS(masked_home, (MOD_LCTL), &kp HOME)
MASK_MODS(masked_end,  (MOD_LCTL), &kp END)

/* Magic-shift & auto-layers */

// Tap: repeat after alpha, else sticky-shift |
// Shift + tap/ double-tap: caps-word | Hold: shift.
#define MAGIC_SHIFT &magic_shift LSHFT 0
ZMK_HOLD_TAP(magic_shift, bindings = <&kp>, <&magic_shift_tap>;
             flavor = "balanced"; tapping-term-ms = <200>;
             quick-tap-ms = <QUICK_TAP_MS>;)
ZMK_MOD_MORPH(magic_shift_tap, bindings = <&shift_repeat>, <&caps_word>;
              mods = <(MOD_LSFT)>;)
ZMK_ADAPTIVE_KEY(
    shift_repeat, bindings = <&sk LSHFT>;
    repeat {
      trigger-keys = <A B C D E F G H I J K L M N O P Q R S T U V W X Y Z>;
      bindings = <&key_repeat>;
      max-prior-idle-ms = <1200>;
      strict-modifiers;
    };)
&caps_word { // Mods deactivate caps-word, requires PR #1451. [TODO: rebase]
  /delete-property/ ignore-modifiers;
};

// Tap: num-word | double-tap: sticky num-layer | Hold: num-layer.
#define SMART_NUM &smart_num NUM 0
ZMK_HOLD_TAP(smart_num, bindings = <&mo>, <&num_dance>; flavor = "balanced";
             tapping-term-ms = <200>; quick-tap-ms = <QUICK_TAP_MS>;)
ZMK_TAP_DANCE(num_dance, bindings = <&num_word NUM>, <&sl NUM>;
              tapping-term-ms = <200>;)

// Smart-mouse, requires tri-state module.
ZMK_TRI_STATE(
    smart_mouse, bindings = <&tog MOUSE>, <&none>, <&tog MOUSE>;
    ignored-key-positions =
        <LT1 LT2 LH0 LH1 RT1 RT2 RT3 RM0 RM1 RM2 RM3 RM4 RB1 RB2 RB3 RH0 RH1>;
    ignored-layers = <MOUSE NAV FN>;)

/* Custom behaviors */

// Alt+Tab swapper, requires tri-state module.
ZMK_TRI_STATE(swapper, bindings = <&kt LALT>, <&kp TAB>, <&kt LALT>;
              ignored-key-positions = <LT2 RT2 RM1 RM2 RM3>;)

// Define mod-morph with a *single* mod trigger for less repetition.
#define SIMPLE_MORPH(NAME, MOD, BINDING1, BINDING2)                            \
  ZMK_MOD_MORPH(NAME, mods = <(MOD_L##MOD | MOD_R##MOD)>;                      \
                bindings = <BINDING1>, <BINDING2>;)

// Tap: comma | Shift + tap: semicolon | Ctrl + shift + tap: <.
SIMPLE_MORPH(comma_morph, SFT, &kp COMMA, &comma_inner_morph)
SIMPLE_MORPH(comma_inner_morph, CTL, &kp SEMICOLON, &kp LESS_THAN)

// Tap: dot | Shift + tap: colon | Ctrl + shift + tap: >.
SIMPLE_MORPH(dot_morph, SFT, &kp DOT, &dot_inner_morph)
SIMPLE_MORPH(dot_inner_morph, CTL, &kp COLON, &kp GREATER_THAN)

// Tap: qmark | Shift + tap: excl.
SIMPLE_MORPH(qexcl, SFT, &kp QMARK, &kp EXCL)

// Tap: left/right parenthesis | Shft + tap: less-than/greater-than.
SIMPLE_MORPH(lpar_lt, SFT, &kp LPAR, &kp LT)
SIMPLE_MORPH(rpar_gt, SFT, &kp RPAR, &kp GT)

// Tap: space | Shift + tap: dot -> space -> sticky shift | Hold: nav layer.
ZMK_HOLD_TAP(lt_spc, bindings = <&mo>, <&spc_morph>; flavor = "balanced";
             tapping-term-ms = <200>; quick-tap-ms = <QUICK_TAP_MS>;)
SIMPLE_MORPH(spc_morph, SFT, &kp SPACE, &dot_spc)
ZMK_MACRO(dot_spc, bindings = <&kp DOT &kp SPACE &sk LSHFT>; wait-ms = <0>;
          tap-ms = <5>;)

// Tap: backspace | Lshft + tap: delete | Rshft + tap: shift-delete.
ZMK_MOD_MORPH(bs_del, bindings = <&kp BSPC>, <&kp DEL>;
              mods = <(MOD_LSFT|MOD_RSFT)>; keep-mods = <MOD_RSFT>;)

// Tap: copy | double-tap: cut.
ZMK_TAP_DANCE(copy_cut, bindings = <&kp LC(INS)>, <&kp LC(X)>;
              tapping-term-ms = <200>;)

// Misc aliases. [TODO: clean up]
#define CANCEL    &to DEF                   // Cancel go to default layer
#define DSK_PREV  &hmr LCTRL LG(LC(LEFT)) // Previous desktop.
#define DSK_NEXT  &hmr LALT LG(LC(RIGHT)) // Next     desktop.
#define PIN_WIN   &kp LG(LC(LS(Q)))       // Pin window across desktops.
#define PIN_APP   &kp LG(LC(LS(A)))       // Pin application across desktops.
#define DSK_MGR   &kp LA(GRAVE)           // Desktop manager.
#define VOL_DOWN  &hmr RSHFT C_VOL_DN


/ {
    behaviors {
        cs_toggle: cs_toggle {
            compatible = "zmk,behavior-macro";
            label = "CTRL_SHIFT_TOGGLE";
            #binding-cells = <0>;
            wait-ms = <0>;
            tap-ms = <0>;
            bindings = <&macro_press &kp LCTRL &kp LSHIFT>
                     , <&macro_pause_for_release>
                     , <&macro_release &kp LCTRL &kp LSHIFT>;
        };
    };
};

/* Keymap */

// ZMK_CONDITIONAL_LAYER(sys, FN NUM, SYS) // FN + NUM --> SYS.

ZMK_BEHAVIOR(my_ht, hold_tap,
    flavor = "hold-preferred";
    tapping-term-ms = <200>;
    quick-tap-ms = <QUICK_TAP_MS>;
    bindings = <&kp>, <&kp>;
)

#ifndef ZMK_BASE_LAYER
  #define ZMK_BASE_LAYER(name, LT, RT, LM, RM, LB, RB, LH, RH)                 \
      ZMK_LAYER(name, LT RT LM RM LB RB LH RH)
#endif

ZMK_BASE_LAYER(Base,
    &kp Q         &kp W         &kp E                &kp R                   &kp T            ,   &kp Y            &kp U         &kp I           &kp O          &kp P          ,
    &kp A         &kp S         &kp D                &hmlm NUM F             &hmlm SYM G      ,   &kp H            &kp J         &kp K           &kp L          &kp SEMI       ,
    &hml LGUI Z   &hml LCTRL X  &hmlm SYM C          &hml LALT V             &hmlm NAV B      ,   &kp N            &hmr LALT M   &hmrm SYM COMMA &hmr LCTRL DOT &hmr LGUI FSLH ,
                                &kp LGUI             &lt_spc NAV 0           &my_ht LSHFT TAB ,   &my_ht LSHFT ESC &lt FN RET    &kp LGUI)
ZMK_BASE_LAYER(Sym,
    &kp EXCL      &kp AT        &kp HASH             &kp CARET               &kp DLLR        ,   &kp PRCNT        &kp LBKT      &kp RBKT        &kp AMPS       &kp BSLH       ,
    &kp GRAVE     &kp TILDE     &kp UNDER            &kp MINUS               &kp EQUAL       ,   &kp EQUAL        &kp LPAR      &kp RPAR        &kp STAR       &kp PIPE       ,
    ___           ___           ___                  &kp PLUS                ___             ,   &kp UNDER        &kp LBRC      &kp RBRC        ___            ___            , 
                                ___                  ___                     ___             ,   ___              ___           ___)
ZMK_BASE_LAYER(Nav,
    ___           &kp LC(W)     &kp LC(LS(TAB))      &kp LC(TAB)             ___             ,   ___              &kp PG_UP     &kp ESC          &kp TAB        ___           ,
    ___           ___           &kp F5               &cs_toggle              &kp LCTRL       ,   &kp LEFT         &kp DOWN      &kp UP           &kp RIGHT      NAV_BSPC      ,
    ___           ___           &kp LA(LEFT)         &kp LA(RIGHT)           ___             ,   &kp HOME         &kp PG_DN     &kp PG_UP        &kp END        NAV_DEL       ,
                                ___                  ___                     &kp LGUI        ,   ___              CANCEL        ___)

ZMK_BASE_LAYER(Fn,
    ___           &kp F9        &kp F8               &kp F7                  &kp F12         ,   ___              &kp C_MUTE    &kp C_VOL_UP     &kp C_BRI_UP  ___            ,
    ___           &kp F6        &kp F5               &kp F4                  &kp F11         ,   &kp C_PP         &kp PSCRN     &kp C_VOL_DN     &kp C_BRI_DN  ___            ,
    ___           &kp F3        &kp F2               &kp F1                  &kp F10         ,   ___              ___           ___              ___           ___            ,
                                ___                  ___                     ___             ,   ___              ___           ___)

ZMK_BASE_LAYER(Game,
    &kp T         &kp Q         &kp W                &kp E                   &kp R           ,   ___              ___           ___              ___           ___            ,
    &kp G         &kp A         &kp S                &kp D                   &kp F           ,   ___              ___           ___              ___           ___            ,
    &kp B         &hml LCTRL Z  &kp X                &hml LALT C             &kp V           ,   ___              ___           ___              ___           ___            ,
                                ___                  ___                     ___             ,   ___              ___           ___)

ZMK_BASE_LAYER(Num,
    &kp N1        &kp N2        &kp N3               &kp N4                  &kp N5          ,   &kp N6           &kp N7        &kp N8           &kp N9        &kp N0         ,
    ___           ___           ___                  ___                     ___             ,   ___              &kp N4        &kp N5           &kp N6        ___            ,
    ___           ___           ___                  ___                     ___             ,   ___              &kp N1        &kp N2           &kp N3        &kp DOT        ,
                                ___                  ___                     &kp LGUI        ,   ___              ___           &kp N0)
ZMK_BASE_LAYER(Sys,
                               _BT_SEL_KEYS_                                                 ,   ___              ___           ___              ___           &soft_off      ,
    ___           ___           &bt BT_CLR           _BT_OUT_                &bootloader     ,   &bootloader      ___           ___              ___           ___            ,
    ___           ___           ___                  _RGB_TOG_               &sys_reset      ,   &sys_reset       ___           ___              ___           ___            ,
                                ___                  ___                     ___             ,   ___              ___           ___)
ZMK_BASE_LAYER(Mouse,
    ___           ___           ___                  ___                     ___             ,   ___              ___           U_MS_U           ___           ___            ,
    ___           ___           ___                  ___                     ___             ,   ___              U_MS_L        U_MS_D           U_MS_R        ___            ,
    ___           ___           ___                  ___                     ___             ,   ___              U_WH_D        U_WH_U           ___           ___            ,
                                ___                  &mkp LCLK               &mkp RCLK       ,   &mkp LCLK        &mkp RCLK     &mkp MCLK)

/* vim: set ft=c tw=146: */
