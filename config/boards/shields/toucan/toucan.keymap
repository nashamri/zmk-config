#define CONFIG_WIRELESS
#define ZMK_BASE_LAYER(name, LT, RT, LM, RM, LB, RB, LH, RH) \
    ZMK_LAYER(                                               \
        name,                                                \
        &kp GRAVE    LT RT    &kp BSPC                       \
        &kp LCTRL    LM RM    &kp SQT                        \
        &kp LSHIFT   LB RB    &kp RCTRL                      \
                     LH RH                                   \
    )

#include "zmk-helpers/key-labels/42.h"
#include "../../../base.keymap"
