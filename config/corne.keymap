#define CONFIG_WIRELESS
#define ZMK_BASE_LAYER(name, LT, RT, LM, RM, LB, RB, LH, RH) \
    ZMK_LAYER(                                               \
        name,                                                \
        &kp GRAVE    LT RT    &kp BSPC                       \
        &kp ESC      LM RM    &kp SQT                        \
        &kp LCTRL    LB RB    &kp RCTRL                      \
                     LH RH                                   \
    )

#include "zmk-helpers/key-labels/42.h"
#include "base.keymap"
