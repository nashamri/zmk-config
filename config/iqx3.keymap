#define CONFIG_WIRELESS
#define RGB
#define ZMK_BASE_LAYER(name, LT, RT, LM, RM, LB, RB, LH, RH) \
    ZMK_LAYER(                                               \
        name,                                                \
        &none                LT RT                &none      \
        &none                LM RM                &none      \
        &none                LB RB                &none      \
        &none  &none  &none  LH RH  &none  &none  &none      \
    )

#include "zmk-helpers/key-labels/4x12.h"
#include <dt-bindings/zmk/rgb.h>
#include "base.keymap"
