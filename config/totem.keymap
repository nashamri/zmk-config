#define CONFIG_WIRELESS
#define ZMK_BASE_LAYER(name, LT, RT, LM, RM, LB, RB, LH, RH) \
    ZMK_LAYER(                                               \
        name,                                                \
                     LT RT                                   \
                     LM RM                                   \
        &kp LCTRL    LB RB    &kp SQT                        \
                     LH RH                                   \
    )

#include "zmk-helpers/key-labels/totem.h"
#include "base.keymap"
